// GBC controller cart: serves the menu ROM from SRAM (cartserve.c), decodes the cart-bus mailbox on
// core0 in run_bus(), and runs the resident pad driver on core1 (driver_core.c).

#include "pico/stdlib.h"
#include "hardware/clocks.h"
#include "hardware/pio.h"
#include "hardware/flash.h"
#include "hardware/sync.h"
#include "hardware/structs/sio.h"
#include "hardware/timer.h"
#include <stdio.h>
#include <string.h>

#include "pinmap.h"
#include "cartserve.h"
#include "psram.h"
#include "rom.h"                // generated by run.sh: gb_rom[GB_ROM_BANKS][16384], in flash
#include "cart_mbc.h"
#include "config_map.h"
#include "ctrl.h"
#include "cable_id.h"
#include "driver_core.h"
#include "pad_catalog.h"
#include "pad_mapinfo.h"
#include "romstore.h"
#include "vmu_stage.h"
#include "vmu_store.h"
#include "vmu_run.h"
#include "vmu_fb.h"
#include "padart.h"
#include "flash_burn.h"

#define FW_VERSION 1

_Static_assert(GB_ROM_BANKS >= 2 && GB_ROM_BANKS <= 16, "every bank is resident: 2-16 banks");

// Banks 0 and 1 are cartserve's own: cs_seed() lands in 0, and 1 is the VMU/art window.
static uint8_t __attribute__((aligned(0x4000))) g_banks[GB_ROM_BANKS > 2 ? GB_ROM_BANKS - 2 : 1][0x4000];
static uint8_t *g_bank_ptr[GB_ROM_BANKS];

// GB -> firmware: writes to $6000+n, n from A0-A2, latched for free by write_capture.
#define MBOX_REGION   0x6000
enum { MBOX_BTN = 0, MBOX_MODE = 1, MBOX_CFG_IDX = 2, MBOX_CFG_VAL = 3, MBOX_COMMIT = 4 };

// firmware -> GB: plain bytes of the served bank 0, rewritten under the console.
#define STATUS_ADDR    0x0010
#define VERSION_ADDR   0x0011
#define ID_ADDR        0x0012   // adapter slot from the cable ID ladder (ADAPT_*)
#define DIAG_ADDR      0x0013   // driver error code, so the ROM can say why nothing is driven
// The PROTO_SEL echo is no proof a driver started; these are what core1 owns and when it acted.
#define ACTIVE_ADDR    0x0014   // PROTO_* of the resident driver, PROTO_NONE if nothing is driven
#define APPLYSEQ_ADDR  0x0015   // low byte of the drv_apply() counter
// The Visual Memory. SEQ is bumped after a whole frame is in place, so the ROM never blits mid-write.
#define VMU_SEQ_ADDR   0x0016
#define VMU_STAT_ADDR  0x0017
#define VMU_SAVES_ADDR 0x0018
// The controller picture staged at $4600 (padart.h). PROTO says whose it is, SEQ that it is whole.
#define ART_SEQ_ADDR   0x0019
#define ART_PROTO_ADDR 0x001a
// pad.h's PAD_* bits 0-23 after map_apply(), low byte first: what core1 drives, not what the GB pressed.
#define PAD_LIVE_ADDR  0x001b
#define PAD_LIVE_SEQ   0x001e   // poked last; the three data bytes are separate pokes and can tear

#define VMU_ST_CARD    0x01     // a card is live
#define VMU_ST_DIRTY   0x02     // writes the flash copy does not have yet
#define VMU_ST_SAVING  0x04     // a writeback is in flight
#define VMU_ST_FRAME   0x08     // the console has drawn to the LCD this session
#define CFG_MIRROR     0x0200   // CFG_LEN bytes, config_map.h
#define CATALOG_ADDR   0x0300   // driver catalog, pad_catalog.h. Seeded once at boot, never rewritten.

#define ST_ALIVE       0x01     // firmware up and serving
#define ST_LINK_UP     0x02     // transport connected
#define ST_FORCE_CFG   0x80     // escape hatch: ROM must leave capture mode

enum { MODE_CONFIG = 0, MODE_CAPTURE = 1 };

static uint8_t  g_config[CFG_LEN];
static volatile uint8_t  g_buttons, g_mode, g_status = ST_ALIVE;
static volatile uint8_t  g_cfg_idx, g_cfg_class, g_adapter, g_diag, g_active, g_aseq;
static volatile bool     g_cfg_dirty, g_commit_req, g_btn_pending;
static volatile uint32_t g_btn_seq, g_wr_count, g_mbox_writes, g_gb_runs;
static uint32_t g_ps_size;


static void publish_status(void) { cs_poke(STATUS_ADDR, g_status); }

static uint8_t g_vmu_stat = VMU_ST_CARD, g_vmu_saves;

// On change, like ACTIVE/APPLYSEQ: the ROM polls these every pass and a poke costs a bus cycle.
static void publish_vmu(void) {
    const vmu_stage_t *s = vmu_stage();
    uint8_t st = (uint8_t)(VMU_ST_CARD
                 | (s->writes != s->saved_writes ? VMU_ST_DIRTY : 0)
                 | (vmu_store_busy() ? VMU_ST_SAVING : 0)
                 | (s->lcd_frames ? VMU_ST_FRAME : 0));

    if (st != g_vmu_stat)              { g_vmu_stat = st;  cs_poke(VMU_STAT_ADDR, st); }
    if ((uint8_t)s->saves != g_vmu_saves) {
        g_vmu_saves = (uint8_t)s->saves;
        cs_poke(VMU_SAVES_ADDR, g_vmu_saves);
    }
}

// On change only, like publish_vmu(): a poke costs a bus cycle and the ROM polls these every pass.
static uint32_t g_pad_live = 0xffffffffU;
static uint8_t  g_pad_live_seq;

static void publish_pad_live(void) {
    uint32_t b = drv_pad_live() & 0xffffffU;
    if (b == g_pad_live) { return; }
    for (unsigned i = 0; i < 3; i++) {
        if (((b ^ g_pad_live) >> (8 * i)) & 0xffU) {
            cs_poke((uint16_t)(PAD_LIVE_ADDR + i), (uint8_t)(b >> (8 * i)));
        }
    }
    g_pad_live = b;
    cs_poke(PAD_LIVE_SEQ, ++g_pad_live_seq);            // after the data, always
}

static void publish_config(void) {
    for (uint32_t i = 0; i < CFG_LEN; i++) { cs_poke(CFG_MIRROR + i, g_config[i]); }
}

// A known cable overrides the selected protocol in g_config itself, so the mirror tells the menu.
static bool cable_select(void) {
#ifdef BENCH_PROTO
    return false;
#else
    uint8_t p = cable_id_proto(g_adapter, g_config[CFG_PROTO_SEL]);
    if (p == g_config[CFG_PROTO_SEL]) { return false; }
    g_config[CFG_PROTO_SEL] = p;
    return true;
#endif
}

// Config lives in the last flash sector. Erasing it live stalls core0, never the SRAM serve path.
#define CFG_FLASH_OFF (PICO_FLASH_SIZE_BYTES - FLASH_SECTOR_SIZE)
#define CFG_MAGIC     0x43474243u
#define CFG_PAGE      (2 * FLASH_PAGE_SIZE)   // magic + CFG_LEN rounded up to a programmable multiple

static void config_load(void) {
    const uint8_t *p = (const uint8_t *)(XIP_BASE + CFG_FLASH_OFF);
    uint32_t magic;
    memcpy(&magic, p, sizeof magic);
    if (magic == CFG_MAGIC) {
        memcpy(g_config, p + 4, CFG_LEN);
    } else {
        memset(g_config, 0xff, CFG_LEN);
    }
}

// core0 only. The erase runs with only core0's interrupts masked, which is safe solely because the
// binary is copy_to_ram and core1 never touches flash, XIP or PSRAM (see pad_driver.h).
static void config_save(void) {
    hard_assert(get_core_num() == 0);
    static uint8_t page[CFG_PAGE];
    uint32_t magic = CFG_MAGIC;
    memset(page, 0xff, sizeof page);
    memcpy(page, &magic, sizeof magic);
    memcpy(page + 4, g_config, CFG_LEN);
    flash_burn(CFG_FLASH_OFF, FLASH_SECTOR_SIZE, page, CFG_PAGE);
}

// Every config change lands here: the menu's mirror, the Transfer Pak slot, then core1.
static void reconfig(uint8_t cls, uint32_t now) {
    publish_config();
    romstore_config(g_config);
    drv_config_changed(g_config, cls, now);
}

#ifdef BENCH_PROTO
static const char k_bench_keys[] = "dawsjknm";   // GB bit order: R L U D A B SELECT START
static uint8_t  g_inject;
static uint32_t g_inject_ms;
static uint8_t  g_bench_slot;   // bench 'g': the Transfer Pak slot the GB menu would have written

void snes_bench_force(uint32_t w, bool on);                     // drivers/snes.c, bench only
void gen_bench_force(uint32_t dpad, uint32_t tltr, bool on);    // drivers/genesis.c, bench only
void gen_bench_stats(uint32_t *polls, uint32_t *resyncs, uint32_t *drops);
void n64_bench_report(void);                                    // drivers/n64.c, bench only
void n64_trace_dump(void);                                      // drivers/n64.c, bench only
void dc_trace_dump(void);                                       // drivers/dc.c, bench only
void maple_vmu_read_cap(unsigned bytes);                        // drivers/maple_proto.c, bench only
static int g_force_bit = -1;

// Bench ']': drive one wire position at a time, bypassing the pad mapping, so the console names
// the bit it perceives. Width and names are per protocol — one shared table would mislabel them.
static void bench_force(int bit) {
    if (g_config[CFG_PROTO_SEL] == PROTO_GENESIS) {
        static const char *k_gen[] = { "D0 UP/Z", "D1 DOWN/Y", "D2 LEFT/X", "D3 RIGHT/MODE",
                                       "TL B/A", "TR C/START", "TL+TR", "all six" };
        // A line held low through every cycle AND both TH halves, so it reads the same wherever
        // the ROM looks and whatever level a disconnected TH happens to float at.
        static const uint8_t k_tt[] = { 0, 0, 0, 0, 0x5, 0xa, 0xf, 0xf };
        uint32_t dp = (bit >= 0 && bit < 4) ? 0x11111111u << bit
                    : (bit == 7)            ? 0xffffffffu : 0;
        uint32_t tt = (bit >= 0) ? k_tt[bit] : 0;
        gen_bench_force(dp, tt, bit >= 0);
        if (bit < 0) printf("force: OFF\n");
        else         printf("force: bit %d = %s  dpad=%08lx tltr=%02lx\n", bit, k_gen[bit],
                            (unsigned long)dp, (unsigned long)tt);
        return;
    }
    static const char *k_snes[16] = { "B", "Y", "SELECT", "START", "UP", "DOWN", "LEFT",
                                      "RIGHT", "A", "X", "L", "R", "id12", "id13",
                                      "id14", "id15" };
    snes_bench_force(bit < 0 ? 0 : 1u << bit, bit >= 0);
    if (bit < 0) printf("force: OFF\n");
    else         printf("force: bit %d = %s\n", bit, k_snes[bit]);
}

static int bench_force_bits(void) {
    return g_config[CFG_PROTO_SEL] == PROTO_GENESIS ? 8 : 16;
}

// Bench 'p': edge census on CTRL0-7 over 200 ms. Input reads only, so it cannot disturb the pins
// core1's driver owns. gpio_hi_in bit 0 is GP32; gpio_get() does not reach GP32+.
static void __not_in_flash_func(ctrl_census)(void) {
    uint32_t edges[PIN_CTRL_N] = { 0 };
    uint32_t prev = sio_hw->gpio_hi_in, n = 0;
    uint32_t t0 = timer_hw->timerawl;
    while (timer_hw->timerawl - t0 < 200000u) {
        uint32_t cur = sio_hw->gpio_hi_in, ch = cur ^ prev;
        for (uint i = 0; i < PIN_CTRL_N; i++)
            if (ch & (1u << (PIN_CTRL0 - 32 + i))) edges[i]++;
        prev = cur;
        n++;
    }
    printf("census 200ms samples=%lu", (unsigned long)n);
    for (uint i = 0; i < PIN_CTRL_N; i++)
        printf(" GP%u=%lu/%u", PIN_CTRL0 + i, (unsigned long)edges[i],
               (unsigned)((prev >> (PIN_CTRL0 - 32 + i)) & 1u));
    printf("\n");
}

// Bench 't': timestamped edge trace of CTRL0-7 over two frames, to order line moves against TH.
#define TRACE_N 224
static uint32_t g_tr_st[TRACE_N], g_tr_ts[TRACE_N];
static void __not_in_flash_func(port_trace)(void) {
    uint32_t mask = 0xffu << (PIN_CTRL0 - 32), n = 0;
    uint32_t save = save_and_disable_interrupts();
    uint32_t prev = sio_hw->gpio_hi_in & mask;
    uint32_t t0 = timer_hw->timerawl;
    while (timer_hw->timerawl - t0 < 50000u && (sio_hw->gpio_hi_in & mask) == prev) { }
    t0 = timer_hw->timerawl;
    while (n < TRACE_N && timer_hw->timerawl - t0 < 34000u) {
        uint32_t cur = sio_hw->gpio_hi_in & mask;
        if (cur != prev) { g_tr_st[n] = cur; g_tr_ts[n] = timer_hw->timerawl - t0; n++; prev = cur; }
    }
    restore_interrupts(save);

    printf("trace %lu edges over 34ms (level 1 = released)\n", (unsigned long)n);
    for (uint32_t i = 0; i < n; i++) {
        uint32_t v = g_tr_st[i] >> (PIN_CTRL0 - 32);
        printf("  %6luus TH=%u D3210=%u%u%u%u TL=%u TR=%u\n", (unsigned long)g_tr_ts[i],
               (unsigned)((v >> 2) & 1u), (unsigned)((v >> 6) & 1u), (unsigned)((v >> 5) & 1u),
               (unsigned)((v >> 4) & 1u), (unsigned)((v >> 3) & 1u),
               (unsigned)(v & 1u), (unsigned)((v >> 1) & 1u));
    }
}

// Bench 'r': cable continuity. Fight each port line with our own pull to tell a console pin from an
// open wire; pulls are a pad setting, so a driver's funcsel is untouched.
static void __not_in_flash_func(wire_probe)(void) {
    printf("wire (pd/pu highs per 4096, no buttons held):\n");
    for (uint i = 0; i < PIN_CTRL_N; i++) {
        uint p = PIN_CTRL(i);
        uint32_t bit = 1u << (p - 32), n[2] = { 0, 0 };
        for (int mode = 0; mode < 2; mode++) {
            gpio_set_pulls(p, mode == 1, mode == 0);         // mode 0 = pull-down, 1 = pull-up
            busy_wait_us_32(1000);                           // RC of a weak pull into cable C
            for (int s = 0; s < 4096; s++)
                if (sio_hw->gpio_hi_in & bit) n[mode]++;
        }
        gpio_disable_pulls(p);

        const char *verdict = "?";
        if (n[0] > 4000 && n[1] > 4000)      verdict = "driven/pulled HIGH externally";
        else if (n[0] < 96 && n[1] < 96)     verdict = "driven LOW externally";
        else if (n[0] < 96 && n[1] > 4000)   verdict = "OPEN - nothing on this wire";
        else                                 verdict = "toggling (console is driving it)";
        printf("  GP%u pd=%lu pu=%lu  %s\n", p, (unsigned long)n[0], (unsigned long)n[1], verdict);
    }
}

// Bench 'z': decode one frame the way the console does — sample DATA1 while CLK is low, 16 clocks
// after LATCH. Returns the word with bit n set = pressed, which is what snes_from_pad() produced.
#define SNIFF_TMO_US 50000
#define SNIFF_WAIT(cond)  do { \
        while (cond) if (timer_hw->timerawl - t0 > SNIFF_TMO_US) return false; \
    } while (0)

// Counts every CLK edge, including inside LATCH: counting only after LATCH, as our SM does, would
// hide a shared off-by-one.
#define SNIFF_MAX_CLK 24
typedef struct {
    uint32_t latch_us, first_us, word, word_late;
    uint32_t in_latch, after;
    uint16_t t_us[SNIFF_MAX_CLK];       // each CLK falling edge, relative to LATCH falling
} sniff_t;

static bool __not_in_flash_func(sniff_frame)(sniff_t *r) {
    const uint32_t L = 1u << (PIN_SNES_LATCH - 32);
    const uint32_t C = 1u << (PIN_SNES_CLK   - 32);
    const uint32_t D = 1u << (PIN_SNES_DATA1 - 32);
    uint32_t t0 = timer_hw->timerawl;

    *r = (sniff_t){ 0 };

    SNIFF_WAIT(sio_hw->gpio_hi_in & L);         // land between frames, not mid-pulse
    SNIFF_WAIT(!(sio_hw->gpio_hi_in & L));      // LATCH rises
    uint32_t t_rise = timer_hw->timerawl, prev = sio_hw->gpio_hi_in;

    while (prev & L) {                          // clocks the console issues while LATCH is high
        uint32_t cur = sio_hw->gpio_hi_in;
        if ((prev & C) && !(cur & C)) {
            if (!(cur & D)) r->word |= 1u << r->in_latch;
            r->in_latch++;
        }
        prev = cur;
        if (timer_hw->timerawl - t0 > SNIFF_TMO_US) return false;
    }
    uint32_t t_fall = timer_hw->timerawl;
    r->latch_us = t_fall - t_rise;

    while (!(prev & L)) {                       // ... and every clock up to the next latch
        uint32_t cur = sio_hw->gpio_hi_in;
        if ((prev & C) && !(cur & C)) {
            uint32_t dt = timer_hw->timerawl - t_fall;
            if (!r->after) r->first_us = dt;
            uint32_t n = r->in_latch + r->after;
            if (n < SNIFF_MAX_CLK) r->t_us[n] = (uint16_t)dt;
            // Data changes on CLK rise; resampling 4 us into the 6 us low phase catches a line
            // still slewing.
            if (n < 32 && !(cur & D)) r->word |= 1u << n;
            uint32_t td = timer_hw->timerawl;
            while (timer_hw->timerawl - td < 4u) { }
            cur = sio_hw->gpio_hi_in;
            if (n < 32 && !(cur & D)) r->word_late |= 1u << n;
            r->after++;
        }
        prev = cur;
        if (timer_hw->timerawl - t0 > SNIFF_TMO_US) break;
    }
    return true;
}

static void __not_in_flash_func(ctrl_sniff)(void) {
    sniff_t r[4];
    // A missed edge is a wrong answer here, and a 6 us CLK low phase is shorter than some of
    // core0's ISRs. Capture with interrupts off, print after.
    uint32_t save = save_and_disable_interrupts();
    bool ok = true;
    for (int f = 0; f < 4 && ok; f++) ok = sniff_frame(&r[f]);
    restore_interrupts(save);

    if (!ok) { printf("sniff: timeout (no latch/clock)\n"); return; }
    for (int f = 0; f < 4; f++) {
        printf("sniff latch=%luus in_latch=%lu after=%lu gb=%02x early=%05lx late=%05lx\n",
               (unsigned long)r[f].latch_us, (unsigned long)r[f].in_latch,
               (unsigned long)r[f].after, g_buttons,
               (unsigned long)r[f].word, (unsigned long)r[f].word_late);
        printf("  dt:");
        uint32_t nc = r[f].after < SNIFF_MAX_CLK ? r[f].after : SNIFF_MAX_CLK;
        for (uint32_t i = 0; i < nc; i++)
            printf(" %u", (unsigned)(i ? r[f].t_us[i] - r[f].t_us[i - 1] : r[f].t_us[0]));
        printf("\n");
    }
}
#endif

static inline uint32_t mbox_index(uint32_t cap) {      // A0-A2, un-permuted
    uint32_t n = 0;
    for (int i = 0; i < 3; i++) { n |= ((cap >> cs_wire_pos[i]) & 1U) << i; }
    return n;
}

static void mbox_write(uint32_t reg, uint8_t v) {
    g_mbox_writes++;
    switch (reg) {
    case MBOX_BTN:     g_buttons = v; g_btn_seq++; g_btn_pending = true; break;
    case MBOX_MODE:    g_mode = v;                  break;
    case MBOX_CFG_IDX: g_cfg_idx = v;               break;
    case MBOX_CFG_VAL:
        g_config[g_cfg_idx] = v;
        // cfg_drv_block() honors the CFG_DRV block only for its stamped owner, so a protocol
        // change invalidates it for free.
        if (g_cfg_idx > CFG_DRV_OWNER) { g_config[CFG_DRV_OWNER] = cfg_proto_sel(g_config); }
        g_cfg_dirty = true;
        g_cfg_class = cfg_class_of(g_cfg_idx);
        break;
    case MBOX_COMMIT:  g_commit_req = true;         break;
    default: break;
    }
}

static void __not_in_flash_func(run_bus)(void) {
    bool rst_was_low = true;
    uint32_t last_ms = 0;
    uint32_t last_id_ms = 0;

    while (true) {
        uint32_t now = to_ms_since_boot(get_absolute_time());

        // Edge-triggered: /reset low->high means the console was released for a fresh run.
        bool rst_low = !(sio_hw->gpio_in & (1U << PIN_RST));
        if (rst_was_low && !rst_low) { g_gb_runs++; }
        // Falling edge: release everything, or the target and the ROM's picture keep whatever was
        // held at reset.
        if (!rst_was_low && rst_low) {
            g_buttons = 0; drv_pad_release(now); publish_pad_live();
            cs_mbc_reset();                 // a DMA mount survives /RST, a real MBC5 does not
        }
        rst_was_low = rst_low;

        // One latched word per write cycle: GP6->bit0 .. GP31->bit25 (serve.pio). Decode only from
        // this word, never a live gpio_in read, so a late core0 cannot see stale data.
        while (!pio_sm_is_rx_fifo_empty(pio1, CS_SM_WCAP)) {
            uint32_t w = pio_sm_get(pio1, CS_SM_WCAP);
            g_wr_count++;
            if (w & (1U << 1)) {
                continue; // A15: internal space (PIO gates too)
            }
            uint32_t a14 = w & 1U;                             // A14 = GP6 = bit0
            uint8_t  data = (w >> 2) & 0xFF;                   // D0-D7 = GP8-15 = bits2-9
            uint32_t cap  = (w >> 12) & 0x3FFF;                // A0-A13 = GP18-31 = bits12-25
            uint32_t a13 = (cap >> cs_wire_pos[13]) & 1U;
            uint32_t a12 = (cap >> cs_wire_pos[12]) & 1U;
            if (((a14 << 14) | (a13 << 13) | (a12 << 12)) != MBOX_REGION) { continue; }
            mbox_write(mbox_index(cap), data);
        }

#ifdef BENCH_PROTO
        // Bench only: a console keystroke stands in for the GB, held 400 ms then released.
        int ch = getchar_timeout_us(0);
        if (ch >= 0) printf("key: %02x\n", ch);      // readback: a silent key is an input problem
        if (ch == 'p') {
            ctrl_census();
        } else if (ch == 'z') {
            ctrl_sniff();
        } else if (ch == 't') {
            port_trace();
        } else if (ch == 'r') {
            wire_probe();       // not 'w': k_bench_keys needs that one for UP
        } else if (ch == 'u') {
            if (g_config[CFG_PROTO_SEL] == PROTO_N64) n64_trace_dump();
            else if (g_config[CFG_PROTO_SEL] == PROTO_DREAMCAST) dc_trace_dump();
        } else if (ch == 'g') {
            // The same writes and commit scr_roms.c makes, so the bench exercises the real path;
            // without the commit a reflash drops the pak back to "no cart".
            g_bench_slot = g_bench_slot >= GB_SLOTS ? 0 : (uint8_t)(g_bench_slot + 1);
            mbox_write(MBOX_CFG_IDX, CFG_DRV + GB_CFG_SLOT_OFF);
            mbox_write(MBOX_CFG_VAL, g_bench_slot);
            mbox_write(MBOX_COMMIT, 1);
            printf("tpak slot -> %u\n", g_bench_slot);
        } else if (ch == 'x') {
            // RIGHT UP A B SELECT START: 0xff would put L+R and U+D on the wire, which the
            // console resolves to one direction and looks like a mapping bug.
            g_inject = 0xf5;
            g_inject_ms = now;
        } else if (ch == 'c') {
            static const unsigned k_caps[] = { 0, 256, 128, 64, 32 };
            static unsigned ci;
            ci = (ci + 1u) % (sizeof k_caps / sizeof k_caps[0]);
            maple_vmu_read_cap(k_caps[ci]);
            printf("bread payload cap -> %u bytes\n", k_caps[ci] ? k_caps[ci] : 512u);
        } else if (ch == 'v') {
            vmu_store_report();
            vmu_store_force();
        } else if (ch == 'l') {
            vmu_fb_test_toggle();
            printf("vmu test pattern %s\n", vmu_fb_test_active() ? "on" : "off");
        } else if (ch == 'o') {
            g_force_bit = -1;
            bench_force(-1);
        } else if (ch == ']') {
            g_force_bit = g_force_bit >= bench_force_bits() - 1 ? -1 : g_force_bit + 1;
            bench_force(g_force_bit);
        } else if (ch >= 0) {
            const char *p = strchr(k_bench_keys, ch);
            if (p && *p) { g_inject = (uint8_t)(1u << (p - k_bench_keys)); g_inject_ms = now; }
        }
        if (g_inject) {
            bool held = (now - g_inject_ms) < 400;
            g_buttons = held ? g_inject : 0;
            g_btn_pending = true;
            if (!held) g_inject = 0;
        }
#endif

        // One publish per drain, not per FIFO word: a burst of button writes costs one.
        if (g_btn_pending) {
            g_btn_pending = false;
            drv_pad_from_gb(g_buttons, now);
            publish_pad_live();         // after map_apply(), so the picture shows the remap
        }

        romstore_poll(now);
        vmu_store_poll(now);

        // A card in a controller is in slave mode; one on its own runs its game. The quiet test
        // is also what keeps core1 and core0 from writing the card at the same time (vmu_run.h).
        vmu_run_gate(drv_resident_proto() == PROTO_DREAMCAST && !drv_link_up(), now);
        vmu_run_poll(now, g_buttons);
        publish_vmu();

        // Last, after the frame's bank is mounted: a torn buffer is never announced.
        uint8_t fseq = vmu_fb_poll();
        if (fseq) { cs_poke(VMU_SEQ_ADDR, fseq); }

        // Same discipline one window up: whose picture it is, then the sequence that says it is
        // whole. The ROM never paints from a half-staged blob because it waits on the second poke.
        uint8_t artseq = padart_poll(g_active);
        if (artseq) { cs_poke(ART_PROTO_ADDR, padart_proto()); cs_poke(ART_SEQ_ADDR, artseq); }

        // A W25Q128 sector erase takes XIP away for up to 400 ms, which no Joybus accessory
        // timeout survives. Hold the commit — g_commit_req stays set — until the N64 goes quiet.
        bool commit = g_commit_req && romstore_flash_ok(now);
        if (commit || g_cfg_dirty) {
            if (commit) {
                g_commit_req = false;
            } else {
                g_cfg_dirty = false;
            }
            cable_select();
            if (commit) { config_save(); }
            reconfig(g_cfg_class, now);
            g_cfg_class = CFG_CLASS_NONE;
        }

        // On change, not on the 500 ms tick: this is the ROM's acknowledgment of a config write.
        // The diag byte rides along so the menu never shows the previous driver's failure.
        uint8_t act = drv_resident_proto();
        uint8_t aseq = (uint8_t)drv_apply_count();
        uint8_t dg  = (uint8_t)drv_error();
        if (act  != g_active) { g_active = act;  cs_poke(ACTIVE_ADDR,   act);  }
        if (aseq != g_aseq)   { g_aseq   = aseq; cs_poke(APPLYSEQ_ADDR, aseq); }
        if (dg   != g_diag)   { g_diag   = dg;   cs_poke(DIAG_ADDR,     dg);   }

        if (now - last_id_ms >= CABLE_ID_TICK_MS) {
            last_id_ms = now;
            uint8_t id = cable_id_tick();
            if (id != g_adapter) {
                g_adapter = id;
                if (cable_select()) { reconfig(CFG_CLASS_PROTO, now); }
                drv_cable_changed(now);
            }
        }

        if (now - last_ms >= 500) {
            last_ms = now;

            // g_status stays single-writer on core0; the driver only owns the predicate.
            bool link = drv_link_up();
            g_diag = (uint8_t)drv_error();
            bool force_cfg = !link && (!drv_cable_ok(g_config) || g_diag != 0
                                       || cfg_proto_sel(g_config) == PROTO_NONE);
            g_status = (uint8_t)(ST_ALIVE | (link ? ST_LINK_UP : 0)
                                          | (force_cfg ? ST_FORCE_CFG : 0));
            publish_status();
            cs_poke(ID_ADDR, g_adapter);
            cs_poke(DIAG_ADDR, g_diag);
            cs_poke(ACTIVE_ADDR, g_active);      // belt and braces over the publish-on-change
            cs_poke(APPLYSEQ_ADDR, g_aseq);

            printf("fw=%u sysclk=%luMHz mode=%s btn=%02x seq=%lu wr=%lu mbox=%lu runs=%lu psram=%lu "
                   "drv=%s link=%d id=%u/%umV err=%d svc=%lu bank=%d\n",
                   FW_VERSION, (unsigned long)(clock_get_hz(clk_sys) / 1000000),
                   g_mode == MODE_CAPTURE ? "capture" : "config",
                   g_buttons, (unsigned long)g_btn_seq, (unsigned long)g_wr_count,
                   (unsigned long)g_mbox_writes, (unsigned long)g_gb_runs,
                   (unsigned long)g_ps_size,
                   drv_name(), link, g_adapter, cable_id_mv(), (int)drv_error(),
                   (unsigned long)drv_service_count(), cs_mbc_bank());
            if (vmu_run_active()) { vmu_run_report(); }
#ifdef BENCH_PROTO
            if (g_config[CFG_PROTO_SEL] == PROTO_GENESIS) {
                // Rates, not totals: edges/s is what names the console's read loop.
                static uint32_t p0, r0;
                uint32_t p, r, d;
                gen_bench_stats(&p, &r, &d);
                printf("  gen: %lu edges/s  %lu resync/s  drops=%lu\n",
                       (unsigned long)((p - p0) * 2u), (unsigned long)((r - r0) * 2u),
                       (unsigned long)d);
                p0 = p; r0 = r;
            }
            if (g_config[CFG_PROTO_SEL] == PROTO_N64) n64_bench_report();
#endif
        }
    }
}

int main(void) {
    // Hold the console before anything else can fail. The pad default already holds it via the
    // gate pull-up; this makes it explicit and independent of the pad reset state.
    cs_rsthold_assert();
    // Before anything that can fail. The port can source 5 V and a driven pin into an unknown
    // cable is not something to leave to the pad reset state.
    ctrl_init_safe();

    cs_set_operating_point();

    cs_rsthold_arm_failsafe();

    cs_bus_priority();

    // UART1 on GP40/GP5 (J4), plus a CDC on J2 when USB_CONSOLE is on.
    stdio_init_all();

    // Probed only for the boot log. After the final clock (timing derives from clk_sys), before core1
    // and the serve PIO (its QMI direct mode takes XIP away).
    g_ps_size = (uint32_t)psram_init(PSRAM_CS_PIN);

    config_load();
#ifdef BENCH_PROTO
    g_config[CFG_PROTO_SEL] = BENCH_PROTO;   // bench build: no GB to write $6002/$6003
#endif
    cable_id_init();
    romstore_init();
    vmu_store_init();               // before the console runs: dc_init() serves whatever it loaded
    vmu_run_init();                 // after it: the emulated card runs whatever the slot held
    romstore_config(g_config);
    drv_init_core0(g_config);
    for (unsigned b = 0; b < GB_ROM_BANKS; b++) {
        g_bank_ptr[b] = b < 2 ? cs_bank((int)b) : g_banks[b - 2];
        cs_load(g_bank_ptr[b], gb_rom[b], 0x4000);
    }
    vmu_fb_init();                          // after the high bank is loaded: it clones it
    padart_init();                          // ... and after that clone, or it captures a stale bank
    cs_seed(STATUS_ADDR, g_status);
    cs_seed(VERSION_ADDR, FW_VERSION);
    cs_seed(VMU_SEQ_ADDR, 0);
    cs_seed(VMU_STAT_ADDR, g_vmu_stat);     // unseeded these read $FF, i.e. dirty and saving
    cs_seed(VMU_SAVES_ADDR, 0);
    for (uint32_t i = 0; i < CFG_LEN; i++) { cs_seed(CFG_MIRROR + i, g_config[i]); }
    static uint8_t cat[CAT_PAGE_LEN];
    pad_catalog_build(cat, pad_driver_table(), pad_driver_count());
    for (uint32_t i = 0; i < CAT_PAGE_LEN; i++) { cs_seed(CATALOG_ADDR + i, cat[i]); }
    static uint8_t mpi[PMI_LEN];
    pad_mapinfo_build(mpi, pad_driver_table(), pad_driver_count());
    for (uint32_t i = 0; i < PMI_LEN; i++) { cs_seed(PMI_ADDR + i, mpi[i]); }
    static uint8_t slots[SLOT_PAGE_LEN];
    romstore_build_page(slots);
    for (uint32_t i = 0; i < SLOT_PAGE_LEN; i++) { cs_seed(SLOT_PAGE_ADDR + i, slots[i]); }

    cs_start();
    cs_mbc_start(g_bank_ptr, GB_ROM_BANKS);        // after cs_start(), which resets the bases

    cs_rsthold_release();                          // bus is answering; let the console run

    // After the release: no driver init can eat into the boot-race budget, and a hung driver
    // costs a dead controller port, never a dead console.
    drv_start();

    run_bus();
}
